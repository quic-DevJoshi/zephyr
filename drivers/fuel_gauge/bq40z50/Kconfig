## drivers/fuel_gauge/bq40z50/Kconfig
```kconfig
# Copyright, Qualcomm Invocation Center.

config BQ40Z50
	bool "BQ40Z50 Fuel Gauge"
	default y
	depends on DT_HAS_TI_BQ40Z50_ENABLED
	select I2C
	help
	  Enable I2C-based driver for BQ40Z50 Fuel Gauge.

config EMUL_BQ40Z50
	bool "Emulate an BQ40Z50 fuel gague"
	default y
	depends on EMUL
	depends on BQ40Z50
	help
	  It provides readings which follow a simple sequence, thus allowing
	  test code to check that things are working as expected.
```

## dts/bindings/fuel-gauge/ti,bq40z50.yaml
```yaml
# Copyright, Qualcomm Invocation Center.

description: |
  Texas Instruments BQ40Z50 fuel gauge. For more info visit
  https://www.ti.com/product/BQ40Z50.


compatible: "ti,bq40z50"

include: [i2c-device.yaml, fuel-gauge.yaml]
```
